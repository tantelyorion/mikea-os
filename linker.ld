/*========================================================

                Mikea OS Linker Script

    Architecture : x86_64
    Developer    : Tantely Orion
    Version      : 0.2

========================================================*/

OUTPUT_FORMAT(elf64-x86-64)
OUTPUT_ARCH(i386:x86-64)
ENTRY(_start)

/*
--------------------------------------------------------
Kernel physical load address

Bootloader loads kernel at 1 MiB

--------------------------------------------------------
*/

KERNEL_BASE = 0x00100000;

SECTIONS
{
    . = KERNEL_BASE;

    /*
    ----------------------------------------------------
    Kernel Start
    ----------------------------------------------------
    */

    __kernel_start = .;

    /*
    ----------------------------------------------------
    Text
    ----------------------------------------------------
    */

    .text ALIGN(4096)
    {
        __text_start = .;

        KEEP(*(.multiboot))
        KEEP(*(.multiboot2))

        *(.text)
        *(.text.*)

        __text_end = .;
    }

    /*
    ----------------------------------------------------
    Read Only Data
    ----------------------------------------------------
    */

    .rodata ALIGN(4096)
    {
        __rodata_start = .;

        *(.rodata)
        *(.rodata.*)

        __rodata_end = .;
    }

    /*
    ----------------------------------------------------
    Initialized Data
    ----------------------------------------------------
    */

    .data ALIGN(4096)
    {
        __data_start = .;

        *(.data)
        *(.data.*)

        __data_end = .;
    }

    /*
    ----------------------------------------------------
    Constructors (Future C++)
    ----------------------------------------------------
    */

    .init_array ALIGN(8)
    {
        __init_array_start = .;

        KEEP(*(.init_array))

        __init_array_end = .;
    }

    /*
    ----------------------------------------------------
    Uninitialized Data
    ----------------------------------------------------
    */

    .bss ALIGN(4096)
    {
        __bss_start = .;

        *(COMMON)
        *(.bss)
        *(.bss.*)

        __bss_end = .;
    }

    /*
    ----------------------------------------------------
    Kernel End
    ----------------------------------------------------
    */

    __kernel_end = .;

    /*
    ----------------------------------------------------
    Remove useless sections
    ----------------------------------------------------
    */

    /DISCARD/ :
    {
        *(.comment)
        *(.note*)
        *(.eh_frame)
        *(.eh_frame_hdr)
        *(.gcc_except_table)
    }
}